// Raspberry 3.3v, Arduino 5v lojik seviyesinde çalışır.
#include <SPI.h>

char buf [12];
volatile byte pos;
volatile boolean kesme_geldi;
volatile byte c;

/*
 *  Bağlantı şekli
 *  
 *  RPi   Arduino
 *  MOSI  -> MOSI
 *  CLK   -> CLK
 *  
 *  Raspberry MOSI (19) çıkışı Arduino'nun D12 MISO girişine bağlı
 *  Raspberry SCLK (23) çıkışı Arduino'nun D13 SCLK girişine bağlı
 *  
 *  Arduino pin diagram
 *  D10=SS
 *  D11=MOSI
 *  D12=MISO
 *  D13=CLK
 *  
 *  MISO (Master In Slave Out) - The Slave line for sending data to the master,
 *  MOSI (Master Out Slave In) - The Master line for sending data to the peripherals,
 *  SCK (Serial Clock) - The clock pulses which synchronize data transmission generated by the master
 *  SS (Slave Select) - the pin on each device that the master can use to enable and disable specific devices.
 *  
 */

void setup (void)
{
  // Hata ayıklama konsolu
  Serial.begin (9600);

  // have to send on master in, *slave out*
  pinMode(MISO, OUTPUT);

  // turn on SPI in slave mode
  // SPCR(SPI Control Register)
  SPCR |= _BV(SPE);

  // Veri almaya basla 
  pinMode (SS, INPUT);

  pos = 0;
  kesme_geldi = false;

  // Kesmeyi aktive et
  SPI.attachInterrupt();

}  // Setup sonu


// SPI kesme rutini
ISR (SPI_STC_vect)
{
  // SPI Data Register'dan bir byte yakala
  c = SPDR;
  pos++;
  kesme_geldi = true;
  Serial.println(c);

}  // kesme rutininin sonu


void printBits(byte myByte) {
  for (byte mask = 0x80; mask; mask >>= 1) {
    if (mask  & myByte)
      Serial.print('1');
    else
      Serial.print('0');
  }
}

void loop (void)
{

  delay(1);
  if (kesme_geldi)
  {
    kesme_geldi = false;
    Serial.print("Kesme oldu. pos: ");
    Serial.print(pos);
    Serial.print(" okunan: ");
    Serial.print(c);
    Serial.print(" binary:  ");
    printBits(c);
    Serial.println("");
  }

}
